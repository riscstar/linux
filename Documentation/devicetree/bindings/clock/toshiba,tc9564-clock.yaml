## Documentation/devicetree/bindings/soc/toshiba/toshiba,tc9564-config-syscon.yaml
```yaml
# SPDX-License-Identifier: (GPL-2.0-only OR BSD-2-Clause)
%YAML 1.2
---
$id: http://devicetree.org/schemas/soc/toshiba/toshiba,tc9564-config-syscon.yaml#
$schema: http://devicetree.org/meta-schemas/core.yaml#

title: Toshiba TC9564 Multifunction System Controller

maintainers:
  - Lorenzo Bianconi <lorenzo.bianconi@oss.qualcomm.com>
  - Alex Elder <elder@riscstar.com>
  - Daniel Thompson <daniel@riscstar.com>

description:
  The Toshiba TC9564 is an SoC accessed by a host system through the
  upstream PCIe port on the PCIe switch it implements.  The switch
  includes an embedded PCIe endpoint that provides access to various
  SoC peripherals via its BARs.  These peripherals include a simple
  controller to gate internal clocks, as well as a reset controller.

  The clock controller uses registers within the same page as a reset
  controller, so this system controller controls access to both.

  A total of 21 simple gated clocks are implemented within the SoC.
  At this time, support for enabling and disabling only a subset of
  them is provided at this time.  Similarly, the SoC implements 13
  resets, but currently not all of them can be controlled.

properties:
  compatible:
    items:
      - const: toshiba,tc9564-config-syscon
      - const: syscon

  reg:
    maxItems: 1

  clocks:
    maxItems: 1

  "#clock-cells":
    const: 1
    description:
      Clock ids are defined in <include/dt-bindings/soc/toshiba,tc9564.h>

  "#reset-cells":
    const: 1
    description:
      Reset ids are defined in <include/dt-bindings/soc/toshiba,tc9564.h>

required:
  - compatible
  - reg
  - clocks
  - "#clock-cells"
  - "#reset-cells"

additionalProperties: false

examples:
  - |
    syscon@0 {
        compatible = "toshiba,tc9564-config-syscon", "syscon";
        reg = <0x0 0x2000>;
        clocks = <&tc9564_xo_board>;
        #clock-cells = <1>;
        #reset-cells = <1>;
    };
```

## drivers/soc/toshiba/Kconfig
```kconfig
# SPDX-License-Identifier: GPL-2.0-only

config SOC_TOSHIBA_TC9564_SYSCON
	tristate "Toshiba TC9564 config system controller support"
	depends on TC9564_PCI
	depends on MFD_CORE
	default TC9564_PCI
	help
	  This enables support for the config system controller for the
	  TC9564 SoC.  It implements an MMIO regmap to manage access to
	  two pages of I/O memory, and serves as a clock and reset
	  controller for IP blocks within the chip.
```
